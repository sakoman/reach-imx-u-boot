## board/reachtech/g2c1/Kconfig
```kconfig
if TARGET_G2C1

config SYS_BOARD
	default "g2c1"

config SYS_VENDOR
	default "reachtech"

config SYS_SOC
	default "mxs"

config SYS_CONFIG_NAME
	default "g2c1"

endif
```

## configs/g2c1_mmc_defconfig
```kconfig
CONFIG_SPL=y
# CONFIG_CMD_IMLS is not set
# CONFIG_CMD_FLASH is not set
CONFIG_SYS_EXTRA_OPTIONS="ENV_IS_IN_MMC"
CONFIG_ARM=y
CONFIG_TARGET_G2C1=y
```

## configs/g2c1_nand_defconfig
```kconfig
CONFIG_SPL=y
# CONFIG_CMD_IMLS is not set
# CONFIG_CMD_FLASH is not se
CONFIG_SYS_EXTRA_OPTIONS="ENV_IS_IN_NAND"
CONFIG_ARM=y
CONFIG_TARGET_G2C1=y
```

## configs/reach_rd6_10p_defconfig
```kconfig
CONFIG_ARM=y
CONFIG_ARCH_MX6=y
CONFIG_SYS_TEXT_BASE=0x17800000
CONFIG_TARGET_G2H=y
CONFIG_SYS_EXTRA_OPTIONS="IMX_CONFIG=board/reach/g2h/g2h_solo.cfg,MX6DL,LCD_10_1,RD6_10P"
```

## configs/reach_rd6_57p_defconfig
```kconfig
CONFIG_ARM=y
CONFIG_ARCH_MX6=y
CONFIG_SYS_TEXT_BASE=0x17800000
CONFIG_TARGET_G2H=y
CONFIG_SYS_EXTRA_OPTIONS="IMX_CONFIG=board/reach/g2h/g2h_solo.cfg,MX6DL,LCD_5_7,RD6_57P"
```
